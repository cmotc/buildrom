## buildrom-devel/config/platforms/Config.in
```kconfig
menu "Platform Configuration"

choice
	prompt "Vendor for the platform target"
	default VENDOR_AMD
	help
	  Select the vendor for the platform you are building for.

config VENDOR_AMD
	bool "AMD"

config VENDOR_ARTEC_GROUP
	bool "Artec Group"

config VENDOR_ASUS
	bool "ASUS"
	depends on COREBOOT_V2

config VENDOR_ADVANCED_DIGITAL_LOGIC
	bool "Advanced Digital Logic"

config VENDOR_GIGABYTE
	bool "GIGABYTE"
	depends on COREBOOT_V2

config VENDOR_PC_ENGINES
	bool "PC Engines"

config VENDOR_QEMU
	bool "QEMU Emulator"

config VENDOR_SUPERMICRO
	bool "Supermicro"
	depends on COREBOOT_V2

config VENDOR_TYAN
	bool "Tyan"
	depends on COREBOOT_V2

endchoice

choice
	prompt "Platform target for the ROM"
	default PLATFORM_NORWICH
	help
	  Select the platform you are building for.

config PLATFORM_NORWICH
       bool "AMD Geode LX 'Norwich'"
       depends on VENDOR_AMD
       select PLATFORM
       select PLATFORM_GEODE

config PLATFORM_DBE61
       bool "Artec Group DBE61"
       depends on VENDOR_ARTEC_GROUP
       select PLATFORM
       select PLATFORM_GEODE

config PLATFORM_ALIX1C
       bool "PC Engines ALIX1.C"
       depends on VENDOR_PC_ENGINES
       select PLATFORM
       select PLATFORM_GEODE

config PLATFORM_ALIX2C3
       bool "PC Engines ALIX.2C3"
       depends on VENDOR_PC_ENGINES
       depends on COREBOOT_V3
       select PLATFORM
       select PLATFORM_GEODE

config PLATFORM_MSM800SEV
       bool "Advanced Digital Logic MSM800SEV"
       depends on VENDOR_ADVANCED_DIGITAL_LOGIC
       select PLATFORM
       select PLATFORM_GEODE

config PLATFORM_DB800
	bool "AMD DB800"
	depends on VENDOR_AMD
	depends on COREBOOT_V2
	select PLATFORM
	select PLATFORM_GEODE

config PLATFORM_GA_M57SLI_S4
       bool "GIGABYTE GA-M57SLI-S4"
       depends on VENDOR_GIGABYTE
       depends on COREBOOT_V2
       select PLATFORM
       select PLATFORM_SUPPORT_64BIT

config PLATFORM_ASUS_A8V_E_SE
       bool "ASUS A8V-E SE"
       depends on VENDOR_ASUS
       depends on COREBOOT_V2
       select PLATFORM
       select PLATFORM_SUPPORT_64BIT

config PLATFORM_ASUS_A8N_E
       bool "ASUS A8N-E"
       depends on VENDOR_ASUS
       depends on COREBOOT_V2
       select PLATFORM
       select PLATFORM_SUPPORT_64BIT

config PLATFORM_ASUS_M2V_MX_SE
       bool "ASUS M2V-MX SE"
       depends on VENDOR_ASUS
       depends on COREBOOT_V2
       select PLATFORM
       select PLATFORM_SUPPORT_64BIT

config PLATFORM_GA_2761GXDK
	bool "GIGABYTE GA-2761GXDK"
	depends on VENDOR_GIGABYTE
	depends on COREBOOT_V2
	select PLATFORM
	select PLATFORM_SUPPORT_64BIT

config PLATFORM_TYAN_S2881
       bool "Tyan S2881"
       depends on VENDOR_TYAN
       depends on COREBOOT_V2
       select PLATFORM
       select PLATFORM_SUPPORT_64BIT

config PLATFORM_TYAN_S2882
       bool "Tyan S2882"
       depends on VENDOR_TYAN
       depends on COREBOOT_V2
       select PLATFORM
       select PLATFORM_SUPPORT_64BIT

config PLATFORM_TYAN_S2891
       bool "Tyan S2891"
       depends on VENDOR_TYAN
       depends on COREBOOT_V2
       select PLATFORM
       select PLATFORM_SUPPORT_64BIT

config PLATFORM_TYAN_S2892
       bool "Tyan S2892"
       depends on VENDOR_TYAN
       depends on COREBOOT_V2
       select PLATFORM
       select PLATFORM_SUPPORT_64BIT

config PLATFORM_TYAN_S2895
       bool "Tyan S2895"
       depends on VENDOR_TYAN
       depends on COREBOOT_V2
       select PLATFORM
       select PLATFORM_SUPPORT_64BIT

config PLATFORM_QEMU-X86
       bool "QEMU Emulator"
       depends on VENDOR_QEMU
       select PLATFORM

config PLATFORM_SERENGETI_CHEETAH
       bool "AMD Serengeti-Cheetah"
       depends on VENDOR_AMD
       select PLATFORM
       select PLATFORM_SUPPORT_64BIT

config PLATFORM_SUPERMICRO_H8DMR
       bool "Supermicro H8DMR"
       depends on VENDOR_SUPERMICRO
       depends on COREBOOT_V2
       select PLATFORM
       select PLATFORM_SUPPORT_64BIT

config PLATFORM_SUPERMICRO_H8DME
       bool "Supermicro H8DME"
       depends on VENDOR_SUPERMICRO
       depends on COREBOOT_V2
       select PLATFORM
       select PLATFORM_SUPPORT_64BIT

config PLATFORM_CHEETAH_FAM10
	bool "AMD Serengeti-Cheetah with fam10 processor"
	depends on VENDOR_AMD
	depends on COREBOOT_V2
	select PLATFORM
	select PLATFORM_SUPPORT_64BIT

config PLATFORM_DBM690T
        bool "AMD dbM690T"
        depends on VENDOR_AMD
	depends on COREBOOT_V2
        select PLATFORM
        select PLATFORM_SUPPORT_64BIT
endchoice

choice
	prompt "Geode VSA SMM handler"
	depends on PLATFORM_GEODE
	default VSA_LEGACY
	help
	  Select the SMM handler source to use with Geode platforms.

config VSA_LEGACY
	bool "Legacy VSA binary from AMD"

config VSA_OPENVSA
	bool "OpenVSA"
	depends on EXPERIMENTAL

endchoice


config BUILD_QEMU
	bool "Build QEMU with patches for coreboot"
	depends on PLATFORM_QEMU-X86
	default n
	help
	  Say 'y' here to build a patched version of QEMU to work with
	  coreboot. This downloads the correct version and patches it;
	  it even builds it if you specify the QEMU_CC correctly.

config QEMU_CC
	string "Compiler to use when building QEMU"
	depends on BUILD_QEMU
	default "gcc34"
	help
          QEMU has known problems when built using gcc 4.x.
	  Set this string to point to your compiler (GCC_VER 3.x).

config SIMNOW
	bool "Build for the AMD SimNow (TM) emulator"
	depends on PLATFORM_SERENGETI_CHEETAH || PLATFORM_SERENGETI_CHEETAH_64
	depends on COREBOOT_V2
	default n
	help
	  Say 'y' here to patch the build to work on an
	  emulated platform in the AMD SimNow (TM) simulator.

config AMD_R690_HEADLESS
	bool "Build the R690 platform as headless (without VGA)"
	depends on ADVANCED
	depends on PLATFORM_DBM690T
	default n
	help
	  Say 'y' here to build without the VGA BIOS for the
	  R690 chipset.  This will result in no video graphics
	  for the platform.  This is not likely what you want,
	  so you should say 'n' here unless you are absolutely
	  sure.

config AMD_R690_USE_VBIOS
	bool
	depends on PLATFORM_DBM690T
	depends on !AMD_R690_HEADLESS
	default y

config AMD_R690_CUSTOM_VBIOS
	bool "Specify a custom location for the R690 video BIOS"
	depends on AMD_R690_USE_VBIOS
	help
	  Say 'y' here to specify a custom location for the R690
	  video BIOS file.  Otherwise, it will be looked for in a
	  default location.

config AMD_R690_VBIOS
	string "Location of the RS690 Video BIOS file"
	depends on AMD_R690_CUSTOM_VBIOS
	default ""
	help
	  Specify the full pathname for your RS690 video BIOS file.

endmenu
```
