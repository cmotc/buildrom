## buildrom-devel/Config.in
```kconfig
# The base kbuild file for buildrom

mainmenu "Buildrom Configuration"

config HAVE_DOT_CONFIG
	bool
	default y

config ADVANCED
	bool "Enable advanced operations"
	default n
	help
	  Allow yourself to do advanced developer things

config EXPERIMENTAL
	bool "Enable experimental features"
	default n
	help
		Experimental features are not yet ready for prime time and/or 
		completely broken. The features revealed by this setting are
		likely to be only useful if you are a developer and want to
		hack on buildrom.

		If you are not sure, say no.

menu "Build Options"

config VERBOSE
	bool "See the build output on stdout"
	default n
	help
	  See the entire build output on stdout. Otherwise, it will
	  be saved off in a series of logs

config STORE_SVN_INFO
	bool "Store svn tree information in deployment directory."
	default y
	help
	  Store the output of 'svn diff', 'svn status' and 'svn info' in the
	  deploy/config/svn/ directory. This means the machine used to build 
	  the coreboot image will need to have internet access during the build.
		
	  If you are not sure, say yes.

config MAKE_JOBS
	int "Number of make jobs to run simultaneously (experimental)"
	default 1
	help
	  This can speed the build if you have more than one core that you
	  would like to allow make to use.  If you have a single processor, use
	  the default (1) otherwise, you can specify the number of cores you
	  have plus 1 (for example, specify 5 if you have 4 cores).

	  This option is currently used for the kernel and uClibc packages.
endmenu


menu "coreboot configuration"

choice
	prompt "coreboot version"
	default COREBOOT_V2

config COREBOOT_V2
	bool "coreboot v2"
	help
		Select this option to build a .rom based on the coreboot
		v2 code.  The v2 code is far more stable, and supports many
		different platforms.

config COREBOOT_V3
	bool "coreboot v3"
	depends on EXPERIMENTAL
	help
		Select this option to build a coreboot v3 based ROM.  This
		is experimental, and only supports a few platforms.
endchoice

config COREBOOT_V3_OVERRIDE_ROM_SIZE
	bool "Override default ROM size"
	depends on COREBOOT_V3
	help
		Select this option to specify your own ROM size.  Use this
		option if your chip is a different size than the one that
		typically comes with the board.

config COREBOOT_V3_ROM_SIZE
	int "coreboot v3 romsize in KB"
	default "1024"
	depends on COREBOOT_V3_OVERRIDE_ROM_SIZE
	help
		Specify the ROM size here in KB.

config USE_LZMA
	bool "Enable LZMA compression"
	depends on !(PAYLOAD_OFW && COREBOOT_V2)
	depends on !(PAYLOAD_FILO && COREBOOT_V2)
	depends on !(PAYLOAD_ETHERBOOT && COREBOOT_V2)
	default y
	help
	  Precompress the payload with LZMA when using coreboot v2. This doesn't
	  work for FILO, OFW, or ETHERBOOT.

	  When using COREBOOT_V3, parse the elf and have lar compress the files.
	  This works with all ELF payloads.

config CB_USE_BUILD
	bool "Specify a coreboot build dir"
	depends on ADVANCED
	default n
	help
	  Say 'y' here to specify an existing directory to build 
	  coreboot from - this is useful if you have local development
	  tree you wish to work from

config CB_BUILDDIR
	string "coreboot build directory"
	depends on CB_USE_BUILD

config CB_CUSTOM_REV
	bool "Override the platform coreboot revision"
	depends on ADVANCED && !CB_USE_BUILD
	default n
	help
	  Say 'y' here to overide the default coreboot SVN revsion
  	  from the platform configuration

config CB_REVISION
	string "coreboot revision"
	depends on CB_CUSTOM_REV

endmenu

config PLATFORM
	bool
	default n

config PLATFORM_SUPPORT_64BIT
	bool
	default n

config PLATFORM_GEODE
	bool
	default n

config PAYLOAD_64BIT
	bool
	default n

config TARGET_32BIT
	bool
	depends on !TARGET_64BIT
	default y

config TARGET_64BIT
	bool
	default n

# This config option will only be set by platforms that need it
# (geode + coreboot v2)

config USE_NRV2B
	bool
	depends on PLATFORM_GEODE && COREBOOT_V2
	default y

source config/platforms/Config.in
source config/payloads/Config.in
```

## buildrom-devel/buildrom/Config.in
```kconfig
# The base kbuild file for buildrom

mainmenu "Buildrom Configuration"

config HAVE_DOT_CONFIG
	bool
	default y

config VERBOSE
	bool "See the build output on stdout"
	default n
	help
	  See the entire build output on stdout.  Otherwise, it will
	  be saved off in a series of logs

config ADVANCED
	bool "Enable advanced operations"
	default n
	help
	  Allow yourself to do advanced developer things

menu "LinuxBIOS configuration"

config USE_LZMA
	bool "Enable LZMA compression"
	depends !PAYLOAD_OFW
	default y
	help
	  Allow LZMA compression for the payload.  This doesn't work
	  for OFW.


config LB_USE_BUILD
	bool "Specify a LinuxBIOS build dir"
	depends ADVANCED
	default n
	help
	  Say 'y' here to specify an existing directory to build 
	  LinuxBIOS from - this is useful if you have local development
	  tree you wish to work from

config LB_BUILDDIR
	string "LinuxBIOS build directory"
	depends LB_USE_BUILD

endmenu

config PLATFORM
	bool
	default n

config PAYLOAD
	bool
	default n

source config/platforms/Config.in
source config/payloads/Config.in
```

## buildrom-devel/buildrom/config/payloads/Config.in
```kconfig
# This menu selects the desired packages for the Linux as bootloader
# payload

menu "Payload Configuration"

choice
	prompt "Desired payload"
	default PAYLOAD_KERNEL
	help
	  Buildrom can build a number of different payloads for the ROM

config PAYLOAD_CUSTOM
	bool "Custom Payload"
	select PAYLOAD

config PAYLOAD_ETHERBOOT
	bool "Etherboot"
	select PAYLOAD

config PAYLOAD_FILO
	bool "FILO"
	select PAYLOAD

config PAYLOAD_KERNEL
	bool "Linux kernel payload"
	select PAYLOAD

config PAYLOAD_LAB
	bool "Linux As Bootloader"
	select PAYLOAD

config PAYLOAD_OFW
	bool "OpenFirmware"
	select PAYLOAD

config PAYLOAD_MEMTEST
	bool "Memtest86+"
	select PAYLOAD

endchoice

menu "Custom Payload"
depends PAYLOAD_CUSTOM
config CUSTOM_PAYLOAD
	string "Custom payload filename"
	default ""
	help
	  Specify a filename for the custom ELF payload you wish to attach
	  to the ROM.  You can also specify the custom payload with the
	  CUSTOM_PAYLOAD environment variable.

endmenu
 
menu "Kernel Configuration"
depends PAYLOAD_KERNEL

config CMDLINE
	string "Kernel command line"
	default ""
	help
	  Specify the kernel command line to use for the kernel.  This is
	  passed to mkelfimage when the kernel is built.
endmenu

menu "LAB Configuration"
depends PAYLOAD_LAB

config KBL_KEXEC_ONLY
	bool
	default n

config KBL
	bool "Reduced size kexec-tools"
	default y
	select KBL_KEXEC_ONLY
	help
	  Say 'Y' here to include the the Kexec Bootloader as a cheep
	  substitute for kexec-tools

config BUSYBOX
	bool "Busybox"
	default y
	help
	  Say 'Y' here to include the busybox tools

config BOOTMENU
	bool "Bootmenu"
	default y
	help
	  Say 'Y' here to include the bootmenu selector
	
config OLPCFLASH
	bool "OLPC flash utility"
	depends PLATFORM_OLPC
	default y
	help
	  Say 'Y' here to include the OLPC flash utility

endmenu

menu "Memtest86 Configuration"
depends PAYLOAD_MEMTEST

config MEMTEST_SERIAL
       bool "Configure memtest for serial output"
       default y
       help
         Turn on serial output for memtest86+

endmenu

menu "Etherboot Configuration"
depends PAYLOAD_ETHERBOOT

config ETHERBOOT_DRIVER
	string "Etherboot NIC driver to support"
	default "rtl8139"
	help
	  Specify the etherboot NIC driver to build a ROM for.  See the
	  Etherboot project for more details

endmenu
endmenu
```

## buildrom-devel/buildrom/config/platforms/Config.in
```kconfig
menu "Platform Configuration"

choice
	prompt "Platform target for the ROM"
	default PLATFORM_NORWICH
	help
	  Select the target to build the LinuxBIOS ROM for

config PLATFORM_NORWICH
       bool "AMD Geode LX 'Norwich'"
       select PLATFORM

config PLATFORM_OLPC
       bool "OLPC Laptop"
       select PLATFORM

config PLATFORM_MSM800SEV
       bool "Digital Logic msm800sev"
       select PLATFORM

endchoice
endmenu
```

## buildrom-devel/config/payloads/Config.in
```kconfig
# This menu selects the desired packages for the Linux as bootloader
# payload

menu "Payload Configuration"

choice
	prompt "Desired payload"
	default PAYLOAD_KERNEL
	help
	  Buildrom can build a number of different payloads for the ROM

config PAYLOAD_COREINFO
	bool "Coreinfo"

config PAYLOAD_CUSTOM
	bool "Custom Payload"

config PAYLOAD_GPXE
	depends on EXPERIMENTAL
	bool "GPXE"

config PAYLOAD_ETHERBOOT
	depends on !PLATFORM_M57SLI
	depends on !PLATFORM_TYAN_S2891
	bool "Etherboot"

config PAYLOAD_FILO
	bool "FILO"

config PAYLOAD_GRUB2
	depends on EXPERIMENTAL
	bool "GRUB2"

config PAYLOAD_KERNEL
	depends on !PLATFORM_GA_2761GXDK
	bool "Linux kernel payload"
	select PAYLOAD_64BIT

config PAYLOAD_LAB
	depends on !PLATFORM_GA_2761GXDK
	bool "Linux As Bootloader"
	select PAYLOAD_64BIT

#config PAYLOAD_OFW
#	depends on !PLATFORM_M57SLI
#	depends on !PLATFORM_TYAN_S2891
#	bool "OpenFirmware"

config PAYLOAD_MEMTEST
	depends on !PLATFORM_M57SLI
	depends on !PLATFORM_TYAN_S2891
	bool "Memtest86"

config PAYLOAD_TINT
	bool "TINT (falling blocks game)"
endchoice

choice
	prompt "Desired target architecture"
	depends on PLATFORM_SUPPORT_64BIT && PAYLOAD_64BIT
	default CHOOSE_32BIT
	help
	  Chose the target architecture for the payload.

config CHOOSE_64BIT
	bool "x86_64 (64 bit)"
	select TARGET_64BIT

config CHOOSE_32BIT
	bool "x86 (32 bit)"
	select TARGET_32BIT

endchoice

menu "Custom Payload"
depends on PAYLOAD_CUSTOM
config CUSTOM_PAYLOAD
	string "Custom payload filename"
	default ""
	help
	  Specify a filename for the custom ELF payload you wish to attach
	  to the ROM.  You can also specify the custom payload with the
	  CUSTOM_PAYLOAD environment variable.

endmenu
 
menu "Kernel Configuration"
depends on PAYLOAD_KERNEL

config CMDLINE
	string "Kernel command line"
	default ""
	help
	  Specify the kernel command line to use for the kernel.  This is
	  passed to mkelfimage when the kernel is built.
endmenu

menu "LAB Configuration"
depends on PAYLOAD_LAB

config KBL_KEXEC_ONLY
	bool
	default n

config KBL
	bool "Reduced size kexec-tools"
	default n
	select KBL_KEXEC_ONLY
	help
	  Say 'Y' here to include the the Kexec Bootloader as a cheep
	  substitute for kexec-tools

config LAB_PAUSE
	int "Seconds to pause before booting, to allow access to the busybox environment"
	default 5
	help
		Set the number of seconds you'd like to pause before booting the kexec'ed
		kernel here. During this pause, you can press enter to gain access to the
		busybox environment.

config BUSYBOX
	bool "Busybox"
	default y
	help
	  Say 'Y' here to include the busybox tools

endmenu

menu "Memtest86 Configuration"
depends on PAYLOAD_MEMTEST

config MEMTEST_SERIAL
       bool "Configure memtest for serial output"
       default y
       help
         Turn on serial output for memtest86+

endmenu

menu "Etherboot Configuration"
depends on PAYLOAD_ETHERBOOT

config ETHERBOOT_DRIVER
	string "Etherboot NIC driver to support"
	default "rtl8139"
	help
	  Specify the etherboot NIC driver to build a ROM for.  See the
	  Etherboot project for more details

endmenu

menu "GPXE Configuration"
depends on PAYLOAD_GPXE
depends on EXPERIMENTAL

config GPXE_DRIVER
	string "GPXE NIC driver to support"
	default "rtl8139"
	help
	  Specify the GPXE NIC driver to build a ROM for.  See the
	  GPXE project for more details

endmenu


endmenu
```
